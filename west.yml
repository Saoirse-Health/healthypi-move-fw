## west.yml
```yaml
manifest:
  self:
    west-commands: scripts/west-commands.yml
    
  remotes:
    - name: nrf
      url-base: https://github.com/nrfconnect
    - name: protocentral
      url-base: https://github.com/Protocentral
    - name: saoirse
      url-base: https://github.com/Saoirse-Health

  projects:
    - name: sdk-nrf
      remote: nrf
      path: nrf
      revision: v3.1-branch
      import:
         name-blocklist:
          - ci-tools
          - hal_altera
          - hal_cypress
          - hal_infineon
          - hal_microchip
          - hal_nxp
          - hal_openisa
          - hal_silabs
          - hal_xtensa
          - hal_ti
          - loramac-node
          - net-tools
          - edtt
          - trusted-firmware-m
          - sof
      clone-depth: 1
  
    - name: openppg-zephyr-sample
      url: git@github.com:Saoirse-Health/openppg-zephyr-sample.git
      revision: main               # or a feature branch / SHA
      path: modules/openppg-zephyr-sample

#    - name: max30001
#      repo-path: protocentral_max30001_zephyr_driver
#      remote: protocentral
#      revision: main
#      path: drivers/sensor/max30001
```
