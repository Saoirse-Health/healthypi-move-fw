## prj.conf
```kconfig
# Configure OpenPPG
CONFIG_OPENPPG=y
# # Default frame limit if module doesn't define one
# CONFIG_OPENPPG_MAX_FRAME_BYTES=128

# # Enable a simple test frame generator (optional)
# CONFIG_OPENPPG_TEST_GEN=y

# HealthyPi Move specific configurations
CONFIG_HPI_GSR_SCREEN=y

CONFIG_BT=y
CONFIG_BT_PERIPHERAL=y
CONFIG_BT_BAS=y
CONFIG_BT_HRS=y
CONFIG_BT_DEVICE_NAME="healthypi move"
CONFIG_BT_DEVICE_APPEARANCE=833

CONFIG_BT_RX_STACK_SIZE=4096

CONFIG_BT_DIS=y
CONFIG_BT_DIS_PNP=n
CONFIG_BT_DIS_FW_REV=y
CONFIG_BT_DIS_MANUF="Protocentral"
CONFIG_BT_DIS_MODEL="Move"
#CONFIG_BT_DIS_SETTINGS=y
#CONFIG_BT_DIS_STR_MAX=100

# Reduced Bluetooth data packets for flash optimization
CONFIG_BT_L2CAP_TX_MTU=247
CONFIG_BT_BUF_ACL_RX_SIZE=251
CONFIG_BT_BUF_ACL_TX_SIZE=251
CONFIG_BT_CTLR_DATA_LENGTH_MAX=251

# Memory Configuration - Restored for debugging
CONFIG_HEAP_MEM_POOL_SIZE=24576        
CONFIG_SYSTEM_WORKQUEUE_STACK_SIZE=24576 
CONFIG_MAIN_STACK_SIZE=16384           

CONFIG_PM_OVERRIDE_EXTERNAL_DRIVER_CHECK=y

# Zephyr OS Configuration - Debug enabled
CONFIG_SMF=y
CONFIG_EVENTS=y
CONFIG_CBPRINTF_FP_SUPPORT=y

# Enable debugging features for development
CONFIG_ASSERT=y
CONFIG_DEBUG_INFO=y
CONFIG_DEBUG_THREAD_INFO=y
CONFIG_THREAD_NAME=y
CONFIG_THREAD_STACK_INFO=y

# Size optimization disabled for debugging
#CONFIG_SIZE_OPTIMIZATIONS=y
#CONFIG_COMPILER_OPT="-Os"

# Peripheral device drivers
CONFIG_SENSOR=y
CONFIG_SENSOR_INFO=y
CONFIG_SENSOR_MAX30001=y
CONFIG_SENSOR_MAX32664D=y
CONFIG_SENSOR_MAX30208=y
#CONFIG_SENSOR_MAXM86146=y
CONFIG_SENSOR_MAX32664C=y
CONFIG_SENSOR_ASYNC_API=y

CONFIG_REGULATOR=y
CONFIG_ADC=n

CONFIG_SENSOR_BMI323_HPI=y
CONFIG_RTC=y
CONFIG_RTC_RV8263=y

CONFIG_INPUT=y
CONFIG_INPUT_CHSC5816=y

CONFIG_I2C=y
CONFIG_I2C_NRFX=y
CONFIG_FUEL_GAUGE=y
CONFIG_NRF_FUEL_GAUGE=y
CONFIG_NRF_FUEL_GAUGE_VARIANT_SECONDARY_CELL=y

CONFIG_DISPLAY=y
CONFIG_SH8601=y

CONFIG_INPUT_GPIO_KEYS=y

CONFIG_LED=n
CONFIG_REBOOT=y
CONFIG_PWM=n

# Filesystem & Internal Flash support to store data
CONFIG_FLASH=y
CONFIG_FLASH_MAP=y
CONFIG_FLASH_PAGE_LAYOUT=y
CONFIG_FILE_SYSTEM=y
CONFIG_FILE_SYSTEM_LITTLEFS=y
CONFIG_MPU_ALLOW_FLASH_WRITE=y

# Enabled settings module and FS to store settings
CONFIG_SETTINGS=y
CONFIG_SETTINGS_RUNTIME=y
CONFIG_SETTINGS_FILE=y
CONFIG_SETTINGS_FILE_PATH="/lfs/sys/settings"

CONFIG_NVS=y

# LVGL Library Options - Debug configuration
CONFIG_LVGL=y
CONFIG_LV_COLOR_DEPTH_16=y
CONFIG_LV_COLOR_16_SWAP=y
CONFIG_LV_THEME_DEFAULT_DARK=y
CONFIG_LV_Z_MEM_POOL_SYS_HEAP=y
# Restored LVGL Memory Configuration for debugging
CONFIG_LV_Z_MEM_POOL_SIZE=24576         
#CONFIG_LV_MEM_CUSTOM=y
CONFIG_LV_Z_POINTER_INPUT_MSGQ_COUNT=50
CONFIG_LV_Z_POINTER_INPUT=y
#CONFIG_LV_DISP_DEF_REFR_PERIOD=30

# LVGL Font Options - Reduced font set to save flash
#CONFIG_LV_FONT_MONTSERRAT_12=y
#CONFIG_LV_FONT_MONTSERRAT_14=y
#CONFIG_LV_FONT_MONTSERRAT_16=y
CONFIG_LV_FONT_MONTSERRAT_20=y
CONFIG_LV_FONT_MONTSERRAT_24=y
#CONFIG_LV_FONT_MONTSERRAT_28=y
#CONFIG_LV_FONT_MONTSERRAT_34=y
#CONFIG_LV_FONT_MONTSERRAT_42=y
#CONFIG_LV_FONT_MONTSERRAT_48=y
#CONFIG_LV_FONT_MONTSERRAT_12_SUBPX=y
CONFIG_LV_FONT_DEFAULT_MONTSERRAT_24=y
#CONFIG_LV_USE_FONT_SUBPX=y

CONFIG_LV_USE_LABEL=y
CONFIG_LV_USE_MSGBOX=y
CONFIG_LV_USE_CHART=y
CONFIG_LV_USE_ROLLER=y
CONFIG_LV_USE_BUTTONMATRIX=y
CONFIG_LV_USE_SPINNER=y

CONFIG_LV_USE_CALENDAR=n
CONFIG_LV_USE_CHECKBOX=n
CONFIG_LV_USE_DROPDOWN=n
CONFIG_LV_USE_IMAGEBUTTON=n
CONFIG_LV_USE_KEYBOARD=n
CONFIG_LV_USE_LIST=n
CONFIG_LV_USE_MENU=n
CONFIG_LV_USE_LOTTIE=n
CONFIG_LV_USE_CANVAS=n
CONFIG_LV_USE_ANIMIMG=n
CONFIG_LV_USE_LED=n
CONFIG_LV_USE_LINE=n
CONFIG_LV_USE_SCALE=n
CONFIG_LV_USE_SPINBOX=n
CONFIG_LV_USE_TABLE=n
CONFIG_LV_USE_TABVIEW=n
CONFIG_LV_USE_TILEVIEW=n
CONFIG_LV_USE_WIN=n

# USB Configuration
CONFIG_USB_DEVICE_STACK=y
CONFIG_USB_DEVICE_PRODUCT="healthypi move"
CONFIG_USB_DEVICE_PID=0x0001
CONFIG_USB_DEVICE_VID=0x4440
CONFIG_USB_DEVICE_INITIALIZE_AT_BOOT=n

# Enable the serial MCUmgr transport.
CONFIG_BASE64=y
#CONFIG_MCUMGR_TRANSPORT_UART=y
CONFIG_NORDIC_QSPI_NOR=y
CONFIG_NORDIC_QSPI_NOR_FLASH_LAYOUT_PAGE_SIZE=4096
CONFIG_NORDIC_QSPI_NOR_STACK_WRITE_BUFFER_SIZE=16

CONFIG_PM_PARTITION_REGION_LITTLEFS_EXTERNAL=y
CONFIG_PM_PARTITION_SIZE_LITTLEFS=0x200000
CONFIG_PM_EXTERNAL_FLASH_MCUBOOT_SECONDARY=y

CONFIG_REQUIRES_FULL_LIBC=y
CONFIG_CMSIS_DSP=y
CONFIG_CMSIS_DSP_FILTERING=y

CONFIG_PM=y
CONFIG_PM_DEVICE=y
#CONFIG_PM_DEVICE_RUNTIME=y

# Enable the poweroff command (for power profiling)
CONFIG_POWEROFF=y

CONFIG_ZBUS=y

# Bootloader Configuration
CONFIG_BOOTLOADER_MCUBOOT=y
#CONFIG_SECURE_BOOT=y

# Enable MCUmgr and dependencies.

CONFIG_FLASH=y

CONFIG_MCUMGR=y
CONFIG_IMG_MANAGER=y
CONFIG_MCUMGR_GRP_IMG=y
CONFIG_MCUMGR_GRP_OS=y
CONFIG_MCUMGR_GRP_FS=y

CONFIG_NET_BUF=y
CONFIG_ZCBOR=y
CONFIG_CRC=y
CONFIG_MCUMGR=y
CONFIG_STREAM_FLASH=y
CONFIG_FLASH_MAP=y

CONFIG_MCUMGR_TRANSPORT_BT_REASSEMBLY=y
CONFIG_MCUMGR_TRANSPORT_NETBUF_SIZE=1024
CONFIG_MCUMGR_GRP_OS_MCUMGR_PARAMS=y
CONFIG_MCUMGR_TRANSPORT_WORKQUEUE_STACK_SIZE=2048

CONFIG_MCUMGR_MGMT_NOTIFICATION_HOOKS=y
CONFIG_MCUMGR_GRP_IMG_UPLOAD_CHECK_HOOK=y
CONFIG_MCUMGR_GRP_IMG_STATUS_HOOKS=y

CONFIG_NCS_SAMPLE_MCUMGR_BT_OTA_DFU=y
CONFIG_NCS_SAMPLE_MCUMGR_BT_OTA_DFU_SPEEDUP=y


CONFIG_NCS_APPLICATION_BOOT_BANNER_STRING="HealthyPi Move"

# Debug logging options - Re-enabled for debugging
CONFIG_SERIAL=y
CONFIG_LOG=y
CONFIG_LOG_DEFAULT_LEVEL=2
CONFIG_CONSOLE=y 
CONFIG_UART_CONSOLE=y

CONFIG_USE_SEGGER_RTT=y
CONFIG_SHELL_BACKEND_RTT=y 
CONFIG_LOG_BACKEND_RTT=y

# Enable individual sensor logging for debugging
CONFIG_SENSOR_LOG_LEVEL_INF=y
CONFIG_LV_USE_LOG=n
CONFIG_LV_LOG_LEVEL_WARN=y
CONFIG_DISPLAY_LOG_LEVEL_ERR=y
CONFIG_INPUT_LOG_LEVEL_ERR=y

#Setup individual log levels for each sensor - enabled for debugging
CONFIG_MAX32664C_LOG_LEVEL_INF=y
CONFIG_MAX32664D_LOG_LEVEL_INF=y
CONFIG_BMI323_HPI_LOG_LEVEL_INF=y
CONFIG_MAX30001_LOG_LEVEL_INF=y

CONFIG_MAX32664_UPDATER=y
CONFIG_MAX32664_UPDATER_LOG_LEVEL_ERR=y

# Init changes for QSPI XIP code placement
#CONFIG_CUSTOM_LINKER_SCRIPT="linker_arm_extxip.ld"
#CONFIG_FLASH_INIT_PRIORITY=40
#CONFIG_SHELL_BACKEND_SERIAL_INIT_PRIORITY=50
#CONFIG_CODE_DATA_RELOCATION=y
#CONFIG_NORDIC_QSPI_NOR_XIP=y

# Configure Bluetooth Security Manager
CONFIG_BT_SMP=y
CONFIG_BT_SIGNING=y
CONFIG_BT_BONDABLE=y

CONFIG_BT_KEYS_OVERWRITE_OLDEST=y
CONFIG_BT_MAX_PAIRED=2
CONFIG_BT_SETTINGS=y
```

## src/ble_module.c
```c
/*
 * HealthyPi Move
 * 
 * SPDX-License-Identifier: MIT
 *
 * Copyright (c) 2025 Protocentral Electronics
 *
 * Author: Ashwin Whitchurch, Protocentral Electronics
 * Contact: ashwin@protocentral.com
 *
 * Permission is hereby granted, free of charge, to any person obtaining a copy
 * of this software and associated documentation files (the "Software"), to deal
 * in the Software without restriction, including without limitation the rights
 * to use, copy, modify, merge, publish, distribute, sublicense, and/or sell
 * copies of the Software, and to permit persons to whom the Software is
 * furnished to do so, subject to the following conditions:
 *
 * The above copyright notice and this permission notice shall be included in all
 * copies or substantial portions of the Software.
 *
 * THE SOFTWARE IS PROVIDED "AS IS", WITHOUT WARRANTY OF ANY KIND, EXPRESS OR
 * IMPLIED, INCLUDING BUT NOT LIMITED TO THE WARRANTIES OF MERCHANTABILITY,
 * FITNESS FOR A PARTICULAR PURPOSE AND NONINFRINGEMENT. IN NO EVENT SHALL THE
 * AUTHORS OR COPYRIGHT HOLDERS BE LIABLE FOR ANY CLAIM, DAMAGES OR OTHER
 * LIABILITY, WHETHER IN AN ACTION OF CONTRACT, TORT OR OTHERWISE, ARISING FROM,
 * OUT OF OR IN CONNECTION WITH THE SOFTWARE OR THE USE OR OTHER DEALINGS IN THE
 * SOFTWARE.
 */


#include <zephyr/kernel.h>
#include <zephyr/logging/log.h>

#include <zephyr/bluetooth/bluetooth.h>
#include <zephyr/bluetooth/hci.h>
#include <zephyr/bluetooth/conn.h>
#include <zephyr/bluetooth/uuid.h>
#include <zephyr/bluetooth/gatt.h>
#include <zephyr/bluetooth/services/bas.h>
#include <zephyr/bluetooth/services/hrs.h>
#include <zephyr/sys/ring_buffer.h>
#include <zephyr/zbus/zbus.h>

#include <zephyr/settings/settings.h>
#include <app_version.h>

#include "cmd_module.h"
#include "hpi_common_types.h"
#include "ble_module.h"
#include "ui/move_ui.h"

#define LOG_LEVEL CONFIG_LOG_DEFAULT_LEVEL
LOG_MODULE_REGISTER(ble_module, LOG_LEVEL_DBG);

struct bt_conn *current_conn;

// BLE GATT Identifiers

#define HPI_SPO2_SERVICE BT_UUID_DECLARE_16(BT_UUID_POS_VAL)
#define HPI_SPO2_CHAR BT_UUID_DECLARE_16(BT_UUID_GATT_PLX_SCM_VAL)

#define HPI_TEMP_SERVICE BT_UUID_DECLARE_16(BT_UUID_HTS_VAL)
#define HPI_TEMP_CHAR BT_UUID_DECLARE_16(BT_UUID_TEMPERATURE_VAL)

// ECG/GSR Service 00001122-0000-1000-8000-00805f9b34fb
#define UUID_HPI_ECG_GSR_SERV BT_UUID_DECLARE_128(BT_UUID_128_ENCODE(0x00001122, 0x0000, 0x1000, 0x8000, 0x00805f9b34fb))

// ECG Characteristic 00001424-0000-1000-8000-00805f9b34fb
#define UUID_HPI_ECG_CHAR BT_UUID_DECLARE_128(BT_UUID_128_ENCODE(0x00001424, 0x0000, 0x1000, 0x8000, 0x00805f9b34fb))

// GSR Characteristic babe4a4c-7789-11ed-a1eb-0242ac120002
#define UUID_HPI_GSR_CHAR BT_UUID_DECLARE_128(BT_UUID_128_ENCODE(0xbabe4a4c, 0x7789, 0x11ed, 0xa1eb, 0x0242ac120002))

// PPG Service cd5c7491-4448-7db8-ae4c-d1da8cba36d0
#define UUID_HPI_PPG_SERV BT_UUID_DECLARE_128(BT_UUID_128_ENCODE(0xcd5c7491, 0x4448, 0x7db8, 0xae4c, 0xd1da8cba36d0))

// PPG Wrist Characteristic cd5c1525-4448-7db8-ae4c-d1da8cba36d0
#define UUID_HPI_PPG_WR_CHAR BT_UUID_DECLARE_128(BT_UUID_128_ENCODE(0xcd5c1525, 0x4448, 0x7db8, 0xae4c, 0xd1da8cba36d0))

// PPG Finger Characteristic cd5ca86f-4448-7db8-ae4c-d1da8cba36d0
#define UUID_HPI_PPG_FI_CHAR BT_UUID_DECLARE_128(BT_UUID_128_ENCODE(0xcd5ca86f, 0x4448, 0x7db8, 0xae4c, 0xd1da8cba36d0))

#define CMD_SERVICE_UUID 0xdc, 0xad, 0x7f, 0xc4, 0x23, 0x90, 0x4d, 0xd4, \
						 0x96, 0x8d, 0x0f, 0x97, 0x92, 0x74, 0xbf, 0x01

#define CMD_TX_CHARACTERISTIC_UUID 0xdc, 0xad, 0x7f, 0xc4, 0x23, 0x90, 0x4d, 0xd4, \
								   0x96, 0x8d, 0x0f, 0x97, 0x28, 0x15, 0xbf, 0x01

#define CMD_RX_CHARACTERISTIC_UUID 0xdc, 0xad, 0x7f, 0xc4, 0x23, 0x90, 0x4d, 0xd4, \
								   0x96, 0x8d, 0x0f, 0x97, 0x27, 0x15, 0xbf, 0x01

#define UUID_HPI_CMD_SERVICE BT_UUID_DECLARE_128(CMD_SERVICE_UUID)
#define UUID_HPI_CMD_SERVICE_CHAR_TX BT_UUID_DECLARE_128(CMD_TX_CHARACTERISTIC_UUID)
#define UUID_HPI_CMD_SERVICE_CHAR_RX BT_UUID_DECLARE_128(CMD_RX_CHARACTERISTIC_UUID)

static const struct bt_data ad[] = {
	BT_DATA_BYTES(BT_DATA_FLAGS, (BT_LE_AD_GENERAL | BT_LE_AD_NO_BREDR)),
	BT_DATA_BYTES(BT_DATA_UUID16_ALL,
				  BT_UUID_16_ENCODE(BT_UUID_HRS_VAL),
				  BT_UUID_16_ENCODE(BT_UUID_BAS_VAL),
				  BT_UUID_16_ENCODE(BT_UUID_DIS_VAL))};

static const struct bt_data sd[] = {
	BT_DATA(BT_DATA_NAME_COMPLETE, CONFIG_BT_DEVICE_NAME, sizeof(CONFIG_BT_DEVICE_NAME) - 1),
};

extern struct k_msgq q_cmd_msg;
extern struct k_sem sem_ble_thread_start;

static void spo2_on_cccd_changed(const struct bt_gatt_attr *attr, uint16_t value)
{
}

static void temp_on_cccd_changed(const struct bt_gatt_attr *attr, uint16_t value)
{
}

static void ppg_fi_on_cccd_changed(const struct bt_gatt_attr *attr, uint16_t value)
{
	ARG_UNUSED(attr);
	switch (value)
	{
	case BT_GATT_CCC_NOTIFY:
		LOG_DBG("PPG Finger CCCD subscribed");
		break;
	case BT_GATT_CCC_INDICATE:
		// Start sending stuff via indications
		break;
	case 0:
		LOG_DBG("PPG Finger CCCD unsubscribed");
		break;
	default:
		LOG_DBG("Error, CCCD has been set to an invalid value");
	}
}

static void ecg_on_cccd_changed(const struct bt_gatt_attr *attr, uint16_t value)
{
	ARG_UNUSED(attr);
	switch (value)
	{
	case BT_GATT_CCC_NOTIFY:
		LOG_DBG("ECG CCCD subscribed");
		break;
	case BT_GATT_CCC_INDICATE:
		// Start sending stuff via indications
		break;
	case 0:
		LOG_DBG("ECG CCCD unsubscribed");
		break;
	default:
		LOG_DBG("Error, CCCD has been set to an invalid value");
	}
}

static void gsr_on_cccd_changed(const struct bt_gatt_attr *attr, uint16_t value)
{
	ARG_UNUSED(attr);
	switch (value)
	{
	case BT_GATT_CCC_NOTIFY:
		
		break;
	case BT_GATT_CCC_INDICATE:
		// Start sending stuff via indications
		LOG_DBG("GSR CCCD subscribed");
		break;
	case 0:
		LOG_DBG("GSR CCCD unsubscribed");
		break;
	default:
		LOG_DBG("Error, CCCD has been set to an invalid value");
	}
}

static void ppg_wr_on_cccd_changed(const struct bt_gatt_attr *attr, uint16_t value)
{
	ARG_UNUSED(attr);
	switch (value)
	{
	case BT_GATT_CCC_NOTIFY:
		LOG_DBG("PPG Wrist CCCD subscribed");
		break;
	case BT_GATT_CCC_INDICATE:
		// Start sending stuff via indications
		break;
	case 0:
		LOG_DBG("PPG Wrist CCCD unsubscribed");
		break;
	default:
		LOG_DBG("Error, CCCD has been set to an invalid value");
	}
}

uint8_t in_data_buffer[50];

BT_GATT_SERVICE_DEFINE(hpi_spo2_service,
					   BT_GATT_PRIMARY_SERVICE(HPI_SPO2_SERVICE),
					   BT_GATT_CHARACTERISTIC(HPI_SPO2_CHAR,
											  BT_GATT_CHRC_READ | BT_GATT_CHRC_NOTIFY,
											  BT_GATT_PERM_READ_ENCRYPT,
											  NULL, NULL, NULL),
					   BT_GATT_CCC(spo2_on_cccd_changed,
								   BT_GATT_PERM_READ | BT_GATT_PERM_WRITE), );

BT_GATT_SERVICE_DEFINE(hpi_temp_service,
					   BT_GATT_PRIMARY_SERVICE(HPI_TEMP_SERVICE),
					   BT_GATT_CHARACTERISTIC(HPI_TEMP_CHAR,
											  BT_GATT_CHRC_READ | BT_GATT_CHRC_NOTIFY,
											  BT_GATT_PERM_READ_ENCRYPT,
											  NULL, NULL, NULL),
					   BT_GATT_CCC(temp_on_cccd_changed,
								   BT_GATT_PERM_READ | BT_GATT_PERM_WRITE), );

BT_GATT_SERVICE_DEFINE(hpi_ppg_service,
					   BT_GATT_PRIMARY_SERVICE(UUID_HPI_PPG_SERV),
					   BT_GATT_CHARACTERISTIC(UUID_HPI_PPG_WR_CHAR,
											  BT_GATT_CHRC_READ | BT_GATT_CHRC_NOTIFY,
											  BT_GATT_PERM_READ,
											  NULL, NULL, NULL),
					   BT_GATT_CCC(ppg_wr_on_cccd_changed,
								   BT_GATT_PERM_READ | BT_GATT_PERM_WRITE),
					   BT_GATT_CHARACTERISTIC(UUID_HPI_PPG_FI_CHAR,
											  BT_GATT_CHRC_READ | BT_GATT_CHRC_NOTIFY,
											  BT_GATT_PERM_READ,
											  NULL, NULL, NULL),
					   BT_GATT_CCC(ppg_fi_on_cccd_changed,
								   BT_GATT_PERM_READ | BT_GATT_PERM_WRITE), );

BT_GATT_SERVICE_DEFINE(hpi_ecg_gsr_service,
					   BT_GATT_PRIMARY_SERVICE(UUID_HPI_ECG_GSR_SERV),
					   BT_GATT_CHARACTERISTIC(UUID_HPI_ECG_CHAR,
											  BT_GATT_CHRC_READ | BT_GATT_CHRC_NOTIFY,
											  BT_GATT_PERM_READ,
											  NULL, NULL, NULL),
					   BT_GATT_CCC(ecg_on_cccd_changed,
								   BT_GATT_PERM_READ | BT_GATT_PERM_WRITE),
					   BT_GATT_CHARACTERISTIC(UUID_HPI_GSR_CHAR,
											  BT_GATT_CHRC_READ | BT_GATT_CHRC_NOTIFY,
											  BT_GATT_PERM_READ,
											  NULL, NULL, NULL),
					   BT_GATT_CCC(gsr_on_cccd_changed,
								   BT_GATT_PERM_READ | BT_GATT_PERM_WRITE), );

/* This function is called whenever the RX Characteristic has been written to by a Client */
static ssize_t on_receive_cmd(struct bt_conn *conn,
							  const struct bt_gatt_attr *attr,
							  const void *buf,
							  uint16_t len,
							  uint16_t offset,
							  uint8_t flags)
{
	const uint8_t *buffer = buf;

	// LOG_DBG("Received CMD len %d \n", len);

	/*for (uint8_t i = 0; i < len; i++)
	{
		in_data_buffer[i] = buffer[i];
		printk("%02X", buffer[i]);
	}
	printk("\n");
	*/

	struct hpi_cmd_data_obj_t cmd_data_obj;
	cmd_data_obj.pkt_type = 0x00;
	cmd_data_obj.data_len = len;
	memcpy(cmd_data_obj.data, buffer, len);

	k_msgq_put(&q_cmd_msg, &cmd_data_obj, K_MSEC(100));

	return len;
}

static void cmd_on_cccd_changed(const struct bt_gatt_attr *attr, uint16_t value)
{
	ARG_UNUSED(attr);
	switch (value)
	{
	case BT_GATT_CCC_NOTIFY:
		LOG_DBG("CMD RX/TX CCCD subscribed");
		break;

	case BT_GATT_CCC_INDICATE:
		// Start sending stuff via indications
		break;

	case 0:
		LOG_DBG("CMD RX/TX CCCD unsubscribed");
		break;

	default:
		LOG_DBG("Error, CCCD has been set to an invalid value");
	}
}

BT_GATT_SERVICE_DEFINE(hpi_cmd_service,
					   BT_GATT_PRIMARY_SERVICE(UUID_HPI_CMD_SERVICE),
					   BT_GATT_CHARACTERISTIC(UUID_HPI_CMD_SERVICE_CHAR_TX,
											  BT_GATT_CHRC_WRITE | BT_GATT_CHRC_WRITE_WITHOUT_RESP | BT_GATT_CHRC_READ,
											  BT_GATT_PERM_READ_AUTHEN | BT_GATT_PERM_WRITE_AUTHEN,
											  NULL, on_receive_cmd, NULL),
					   BT_GATT_CHARACTERISTIC(UUID_HPI_CMD_SERVICE_CHAR_RX,
											  BT_GATT_CHRC_NOTIFY | BT_GATT_CHRC_WRITE_WITHOUT_RESP | BT_GATT_CHRC_READ,
											  BT_GATT_PERM_READ_AUTHEN | BT_GATT_PERM_WRITE_AUTHEN,
											  NULL, NULL, NULL),
					   BT_GATT_CCC(cmd_on_cccd_changed,
								   BT_GATT_PERM_READ | BT_GATT_PERM_WRITE), );

void hpi_ble_send_data(const uint8_t *data, uint16_t len)
{

	const struct bt_gatt_attr *attr = &hpi_cmd_service.attrs[4];

	// printk("Sending data len %d \n", len);

	bt_gatt_notify(NULL, attr, data, len);
}

void ble_ppg_notify_wr(uint32_t *ppg_data, uint8_t len)
{
	uint8_t out_data[128];
	const size_t payload_len = (size_t)len * sizeof(uint32_t);

	if (payload_len > sizeof(out_data))
	{
		LOG_WRN("WR PPG payload truncated: %zu > %zu", payload_len, sizeof(out_data));
		len = sizeof(out_data) / sizeof(uint32_t);
	}

	for (int i = 0; i < len; i++)
	{
		out_data[i * 4] = (uint8_t)ppg_data[i];
		out_data[i * 4 + 1] = (uint8_t)(ppg_data[i] >> 8);
		out_data[i * 4 + 2] = (uint8_t)(ppg_data[i] >> 16);
		out_data[i * 4 + 3] = (uint8_t)(ppg_data[i] >> 24);
	}

	// LOG_DBG("PPG Not len %d", len);

	int err = bt_gatt_notify(NULL, &hpi_ppg_service.attrs[2], out_data, len * 4);
	if (err != 0 && err != -ENOTCONN)
	{
		LOG_WRN("bt_gatt_notify (wrist PPG) failed: %d", err);
	}
}

void ble_ppg_notify_fi(uint32_t *ppg_data, uint8_t len)
{
	uint8_t out_data[128];
	const size_t payload_len = (size_t)len * sizeof(uint32_t);

	if (payload_len > sizeof(out_data))
	{
		LOG_WRN("FI PPG payload truncated: %zu > %zu", payload_len, sizeof(out_data));
		len = sizeof(out_data) / sizeof(uint32_t);
	}

	for (int i = 0; i < len; i++)
	{
		out_data[i * 4] = (uint8_t)ppg_data[i];
		out_data[i * 4 + 1] = (uint8_t)(ppg_data[i] >> 8);
		out_data[i * 4 + 2] = (uint8_t)(ppg_data[i] >> 16);
		out_data[i * 4 + 3] = (uint8_t)(ppg_data[i] >> 24);
	}

	// LOG_DBG("PPG Not len %d", len);

	int err = bt_gatt_notify(NULL, &hpi_ppg_service.attrs[4], out_data, len * 4);
	if (err != 0 && err != -ENOTCONN)
	{
		LOG_WRN("bt_gatt_notify (finger PPG) failed: %d", err);
	}
}

void ble_ecg_notify(int32_t *ecg_data, uint8_t len)
{ 
	uint8_t out_data[128];
	
	for (int i = 0; i < len; i++)
	{
		out_data[i * 4] = (uint8_t)ecg_data[i];
		out_data[i * 4 + 1] = (uint8_t)(ecg_data[i] >> 8);
		out_data[i * 4 + 2] = (uint8_t)(ecg_data[i] >> 16);
		out_data[i * 4 + 3] = (uint8_t)(ecg_data[i] >> 24);
	}

	// LOG_DBG("ECG Not len %d", len);

	bt_gatt_notify(NULL, &hpi_ecg_gsr_service.attrs[2], &out_data, len * 4);
}

void ble_gsr_notify(int32_t *gsr_data, uint8_t len)
{
	uint8_t out_data[128];
	int32_t gsr_data_i32 = 0;

	for (int i = 0; i < len; i++)
	{
		out_data[i * 4] = (uint8_t)gsr_data_i32;
		out_data[i * 4 + 1] = (uint8_t)(gsr_data_i32 >> 8);
		out_data[i * 4 + 2] = (uint8_t)(gsr_data_i32 >> 16);
		out_data[i * 4 + 3] = (uint8_t)(gsr_data_i32 >> 24);
	}

	//LOG_DBG("GSR Not len %d", len);

	bt_gatt_notify(NULL, &hpi_ecg_gsr_service.attrs[4], &out_data, len * 4);
}

void ble_bpt_cal_progress_notify(uint8_t bpt_status, uint8_t bpt_progress)
{
	uint8_t out_data[3];

	out_data[0] = bpt_status;
	out_data[1] = bpt_progress;
	out_data[2] = 0x00;

	bt_gatt_notify(NULL, &hpi_cmd_service.attrs[4], &out_data, sizeof(out_data));
}

void ble_hrs_notify(uint16_t hr_val)
{
	bt_hrs_notify(hr_val);
}

void ble_bas_notify(uint8_t batt_level)
{
	bt_bas_set_battery_level(batt_level);
}

static void connected(struct bt_conn *conn, uint8_t err)
{
	char addr[BT_ADDR_LE_STR_LEN];

	bt_addr_le_to_str(bt_conn_get_dst(conn), addr, sizeof(addr));

	if (err)
	{
		LOG_ERR("Failed to connect to %s, err 0x%02x %s\n", addr,
				err, bt_hci_err_to_str(err));
		return;
	}

	LOG_INF("Connected to %s\n", addr);

	if (bt_conn_set_security(conn, BT_SECURITY_L2))
	{
		LOG_ERR("Failed to set security\n");
	}
}

static void disconnected(struct bt_conn *conn, uint8_t reason)
{
	char addr[BT_ADDR_LE_STR_LEN];

	bt_addr_le_to_str(bt_conn_get_dst(conn), addr, sizeof(addr));

	LOG_INF("Disconnected from %s, reason 0x%02x %s\n", addr,
			reason, bt_hci_err_to_str(reason));
}

static void security_changed(struct bt_conn *conn, bt_security_t level,
							 enum bt_security_err err)
{
	char addr[BT_ADDR_LE_STR_LEN];

	bt_addr_le_to_str(bt_conn_get_dst(conn), addr, sizeof(addr));

	if (!err)
	{
		LOG_INF("Security changed: %s level %u\n", addr, level);
	}
	else
	{
		LOG_ERR("Security failed: %s level %u err %s(%d)\n", addr, level,
			   bt_security_err_to_str(err), err);
	}
}

BT_CONN_CB_DEFINE(conn_callbacks) = {
	.connected = connected,
	.disconnected = disconnected,
	.security_changed = security_changed,
};

static void auth_passkey_display(struct bt_conn *conn, unsigned int passkey)
{
	char addr[BT_ADDR_LE_STR_LEN];

	bt_addr_le_to_str(bt_conn_get_dst(conn), addr, sizeof(addr));

	LOG_INF("Passkey for %s: %06u\n", addr, passkey);
	hpi_load_scr_spl(SCR_SPL_BLE, SCROLL_NONE, HPI_BLE_EVENT_PAIR_REQUEST, passkey, 0, 0);
}

static void auth_cancel(struct bt_conn *conn)
{
	char addr[BT_ADDR_LE_STR_LEN];

	bt_addr_le_to_str(bt_conn_get_dst(conn), addr, sizeof(addr));

	LOG_INF("Pairing cancelled: %s\n", addr);
	hpi_load_scr_spl(SCR_SPL_BLE, SCROLL_NONE, HPI_BLE_EVENT_PAIR_CANCELLED, 0, 0, 0);
}

static void pairing_complete(struct bt_conn *conn, bool bonded)
{
	char addr[BT_ADDR_LE_STR_LEN];

	bt_addr_le_to_str(bt_conn_get_dst(conn), addr, sizeof(addr));

	LOG_INF("Pairing completed: %s, bonded: %d\n", addr, bonded);
	hpi_load_scr_spl(SCR_SPL_BLE, SCROLL_NONE, HPI_BLE_EVENT_PAIR_SUCCESS, bonded ? 1 : 0, 0, 0);
}

static void pairing_failed(struct bt_conn *conn, enum bt_security_err reason)
{
	char addr[BT_ADDR_LE_STR_LEN];

	bt_addr_le_to_str(bt_conn_get_dst(conn), addr, sizeof(addr));

	LOG_ERR("Pairing failed conn: %s, reason %d %s\n", addr, reason,
			bt_security_err_to_str(reason));
	hpi_load_scr_spl(SCR_SPL_BLE, SCROLL_NONE, HPI_BLE_EVENT_PAIR_FAILED, reason, 0, 0);
}

static struct bt_conn_auth_cb conn_auth_callbacks = {
	.passkey_display = auth_passkey_display,
	.cancel = auth_cancel,
};

static struct bt_conn_auth_info_cb conn_auth_info_callbacks = {
	.pairing_complete = pairing_complete,
	.pairing_failed = pairing_failed,
};

void ble_module_init()
{
	int err = 0;

	err = bt_enable(NULL);
	if (err)
	{
		LOG_ERR("Bluetooth init failed (err %d)", err);
		return;
	}

	settings_load();

	err = bt_le_adv_start(BT_LE_ADV_CONN, ad, ARRAY_SIZE(ad), sd, ARRAY_SIZE(sd));
	if (err)
	{
		LOG_ERR("Advertising failed to start (err %d)\n", err);
		return;
	}
	else
	{
		LOG_INF("Advertising successfully started");
	}

	bt_conn_auth_cb_register(&conn_auth_callbacks);
	bt_conn_auth_info_cb_register(&conn_auth_info_callbacks);

	LOG_DBG("Bluetooth init !");
}

static uint8_t m_ble_prev_progress = 0;
static uint8_t m_ble_prev_status = 0;

static void ble_bpt_listener(const struct zbus_channel *chan)
{
	const struct hpi_bpt_t *hpi_bpt = zbus_chan_const_msg(chan);
	if (hpi_bpt->progress == m_ble_prev_progress &&
		hpi_bpt->status == m_ble_prev_status)
	{
		return;
	}
	m_ble_prev_progress = hpi_bpt->progress;
	m_ble_prev_status = hpi_bpt->status;

	ble_bpt_cal_progress_notify(hpi_bpt->status, hpi_bpt->progress);
	LOG_DBG("ZB BPT Status: %d Progress: %d\n", hpi_bpt->status, hpi_bpt->progress);
}
ZBUS_LISTENER_DEFINE(ble_bpt_lis, ble_bpt_listener);

void ble_thread(void)
{
	k_sem_take(&sem_ble_thread_start, K_FOREVER);

	LOG_INF("BLE Thread started");

	for (;;)
	{
		k_sleep(K_MSEC(1000));
	}
}

#define BLE_THREAD_STACKSIZE 1024
#define BLE_THREAD_PRIORITY 7

K_THREAD_DEFINE(ble_thread_id, BLE_THREAD_STACKSIZE, ble_thread, NULL, NULL, NULL, BLE_THREAD_PRIORITY, 0, 1000);
```

## src/data_module.c
```c
/*
 * HealthyPi Move
 *
 * SPDX-License-Identifier: MIT
 *
 * Copyright (c) 2025 Protocentral Electronics
 *
 * Author: Ashwin Whitchurch, Protocentral Electronics
 * Contact: ashwin@protocentral.com
 *
 * Permission is hereby granted, free of charge, to any person obtaining a copy
 * of this software and associated documentation files (the "Software"), to deal
 * in the Software without restriction, including without limitation the rights
 * to use, copy, modify, merge, publish, distribute, sublicense, and/or sell
 * copies of the Software, and to permit persons to whom the Software is
 * furnished to do so, subject to the following conditions:
 *
 * The above copyright notice and this permission notice shall be included in all
 * copies or substantial portions of the Software.
 *
 * THE SOFTWARE IS PROVIDED "AS IS", WITHOUT WARRANTY OF ANY KIND, EXPRESS OR
 * IMPLIED, INCLUDING BUT NOT LIMITED TO THE WARRANTIES OF MERCHANTABILITY,
 * FITNESS FOR A PARTICULAR PURPOSE AND NONINFRINGEMENT. IN NO EVENT SHALL THE
 * AUTHORS OR COPYRIGHT HOLDERS BE LIABLE FOR ANY CLAIM, DAMAGES OR OTHER
 * LIABILITY, WHETHER IN AN ACTION OF CONTRACT, TORT OR OTHERWISE, ARISING FROM,
 * OUT OF OR IN CONNECTION WITH THE SOFTWARE OR THE USE OR OTHER DEALINGS IN THE
 * SOFTWARE.
 */

#include <zephyr/kernel.h>
#include <zephyr/device.h>
#include <zephyr/drivers/sensor.h>
#include <stdio.h>
#include <math.h>
#include <arm_math.h>

#include <zephyr/logging/log.h>
#include <zephyr/zbus/zbus.h>
#include <time.h>

LOG_MODULE_REGISTER(data_module, LOG_LEVEL_DBG);

#include "max30001.h"

#include "hw_module.h"
#include "hpi_common_types.h"
#include "fs_module.h"
#include "ble_module.h"
#include "algos.h"
#include "ui/move_ui.h"
#include "hpi_sys.h"

#include "log_module.h"

#if IS_ENABLED(CONFIG_OPENPPG)
#include "hpi_openppg.h"
#endif

// ProtoCentral data formats
#define CES_CMDIF_PKT_START_1 0x0A
#define CES_CMDIF_PKT_START_2 0xFA
#define CES_CMDIF_TYPE_DATA 0x02
#define CES_CMDIF_PKT_STOP 0x0B
#define DATA_LEN 22

#define LOG_SAMPLE_RATE_SPS 125
#define SAMPLE_BUFF_WATERMARK 8

char DataPacket[DATA_LEN];
const char DataPacketFooter[2] = {0, CES_CMDIF_PKT_STOP};
const char DataPacketHeader[5] = {CES_CMDIF_PKT_START_1, CES_CMDIF_PKT_START_2, DATA_LEN, 0, CES_CMDIF_TYPE_DATA};

extern const struct device *const max30001_dev;
extern const struct device *const max32664d_dev;

static bool settings_send_usb_enabled = false;
static bool settings_send_ble_enabled = true;
static bool settings_plot_enabled = true;

enum hpi5_data_format
{
    DATA_FMT_OPENVIEW,
    DATA_FMT_PLAIN_TEXT,
} hpi5_data_format_t;

static bool settings_log_data_enabled = true; // true;
static int settings_data_format = DATA_FMT_OPENVIEW;

// struct hpi_ecg_bioz_sensor_data_t log_buffer[LOG_BUFFER_LENGTH];

uint16_t current_session_log_counter = 0;
uint16_t current_session_log_id = 0;
char session_id_str[5];

static bool is_ecg_record_active = false;
static int32_t ecg_record_buffer[ECG_RECORD_BUFFER_SAMPLES]; // 128*30 = 3840
static volatile uint16_t ecg_record_counter = 0;
K_MUTEX_DEFINE(mutex_is_ecg_record_active);

static bool is_gsr_measurement_active = false;
K_MUTEX_DEFINE(mutex_is_gsr_measurement_active);

static uint32_t last_hr_update_time = 0;

K_MUTEX_DEFINE(mutex_hr_change);

// Externs

ZBUS_CHAN_DECLARE(hr_chan);

ZBUS_CHAN_DECLARE(ecg_stat_chan);

extern struct k_msgq q_ecg_sample;
extern struct k_msgq q_bioz_sample;
extern struct k_msgq q_ppg_wrist_sample;
extern struct k_msgq q_ppg_fi_sample;

extern struct k_msgq q_plot_ecg;
extern struct k_msgq q_plot_ppg_wrist;
extern struct k_msgq q_plot_ppg_fi;
extern struct k_msgq q_plot_hrv;
extern struct k_msgq q_plot_gsr;

void sendData(int32_t ecg_sample, int32_t bioz_sample, uint32_t raw_red, uint32_t raw_ir, int32_t temp, uint8_t hr,
              uint8_t bpt_status, uint8_t spo2, bool _bioZSkipSample)
{
    DataPacket[0] = ecg_sample;
    DataPacket[1] = ecg_sample >> 8;
    DataPacket[2] = ecg_sample >> 16;
    DataPacket[3] = ecg_sample >> 24;

    DataPacket[4] = bioz_sample;
    DataPacket[5] = bioz_sample >> 8;
    DataPacket[6] = bioz_sample >> 16;
    DataPacket[7] = bioz_sample >> 24;

    if (_bioZSkipSample == false)
    {
        DataPacket[8] = 0x00;
    }
    else
    {
        DataPacket[8] = 0xFF;
    }

    DataPacket[9] = raw_red;
    DataPacket[10] = raw_red >> 8;
    DataPacket[11] = raw_red >> 16;
    DataPacket[12] = raw_red >> 24;

    DataPacket[13] = raw_ir;
    DataPacket[14] = raw_ir >> 8;
    DataPacket[15] = raw_ir >> 16;
    DataPacket[16] = raw_ir >> 24;

    DataPacket[17] = temp;
    DataPacket[18] = temp >> 8;

    DataPacket[19] = spo2;
    DataPacket[20] = hr;
    DataPacket[21] = bpt_status;

    if (settings_send_usb_enabled)
    {
        send_usb_cdc(DataPacketHeader, 5);
        send_usb_cdc(DataPacket, DATA_LEN);
        send_usb_cdc(DataPacketFooter, 2);
    }
}

static int hpi_get_trend_stats(uint16_t *in_array, uint16_t in_array_len, uint16_t *out_max, uint16_t *out_min, uint16_t *out_mean)
{
    if (in_array_len == 0)
    {
        return -1;
    }

    uint16_t max = in_array[0];
    uint16_t min = in_array[0];
    uint32_t sum = 0;

    for (int i = 0; i < in_array_len; i++)
    {
        if (in_array[i] > max)
        {
            max = in_array[i];
        }
        if (in_array[i] < min)
        {
            min = in_array[i];
        }
        sum += in_array[i];
    }

    *out_max = max;
    *out_min = min;
    *out_mean = sum / in_array_len;

    return 0;
}

void send_data_text(int32_t ecg_sample, int32_t bioz_sample, int32_t raw_red)
{
    char data[100];
    double f_ecg_sample = (double)ecg_sample / 1000;
    double f_bioz_sample = (double)bioz_sample / 1000;
    double f_raw_red = (double)raw_red / 1000;

    sprintf(data, "%.3f\t%.3f\t%.3f\r\n", f_ecg_sample, f_bioz_sample, f_raw_red);

    if (settings_send_usb_enabled)
    {
        send_usb_cdc(data, strlen(data));
    }
}

void send_data_text_1(int32_t in_sample)
{
    char data[100];
    float f_in_sample = (float)in_sample / 1000;

    sprintf(data, "%.3f\r\n", f_in_sample);
    send_usb_cdc(data, strlen(data));
}

static void work_ecg_write_file_handler(struct k_work *work)
{
    struct tm tm_sys_time = hpi_sys_get_sys_time();
    int64_t log_time = timeutil_timegm64(&tm_sys_time);

    // Write ECG data to file
    hpi_write_ecg_record_file(ecg_record_buffer, ECG_RECORD_BUFFER_SAMPLES, log_time);
}

K_WORK_DEFINE(work_ecg_write_file, work_ecg_write_file_handler);

void hpi_data_set_ecg_record_active(bool active)
{
    k_mutex_lock(&mutex_is_ecg_record_active, K_FOREVER);
    is_ecg_record_active = active;

    if (active)
    {
        ecg_record_counter = 0;
        memset(ecg_record_buffer, 0, sizeof(ecg_record_buffer));
    }
    else
    {
        // If recording is stopped, write the file
        if (ecg_record_counter > 0)
        {
            k_work_submit(&work_ecg_write_file);
        }
    }
    k_mutex_unlock(&mutex_is_ecg_record_active);
}

bool hpi_data_is_ecg_record_active(void)
{
    bool active;
    k_mutex_lock(&mutex_is_ecg_record_active, K_FOREVER);
    active = is_ecg_record_active;
    k_mutex_unlock(&mutex_is_ecg_record_active);
    return active;
}

void hpi_data_set_gsr_measurement_active(bool active)
{
    k_mutex_lock(&mutex_is_gsr_measurement_active, K_FOREVER);
    is_gsr_measurement_active = active;
    k_mutex_unlock(&mutex_is_gsr_measurement_active);
}

bool hpi_data_is_gsr_measurement_active(void)
{
    bool active = false;
    k_mutex_lock(&mutex_is_gsr_measurement_active, K_FOREVER);
    active = is_gsr_measurement_active;
    k_mutex_unlock(&mutex_is_gsr_measurement_active);
    return active;
}

void data_thread(void)
{
    struct hpi_ecg_bioz_sensor_data_t ecg_sensor_sample;
    struct hpi_ppg_wr_data_t ppg_wr_sensor_sample;
    struct hpi_ppg_fi_data_t ppg_fi_sensor_sample;
    struct hpi_bioz_sample_t bsample;

    static uint32_t hr_zbus_last_pub_time = 0;

    LOG_INF("Data Thread starting");

#if IS_ENABLED(CONFIG_OPENPPG)
    int rc = hpi_openppg_init();
    if (rc != 0)
    {
        LOG_ERR("OpenPPG init failed (%d)", rc);
    }

    rc = hpi_openppg_configure_ppg(0, true);
    if (rc != 0)
    {
        LOG_ERR("OpenPPG configure failed (%d)", rc);
    }
#endif

    for (;;)
    {
        bool processed_data = false;

        // Process all available ECG samples (unchanged)
        if (k_msgq_get(&q_ecg_sample, &ecg_sensor_sample, K_NO_WAIT) == 0)
        {
            processed_data = true;
            if (settings_send_ble_enabled)
            {

                ble_ecg_notify(ecg_sensor_sample.ecg_samples, ecg_sensor_sample.ecg_num_samples);
                ble_gsr_notify(ecg_sensor_sample.ecg_samples, ecg_sensor_sample.ecg_num_samples);
            }
            if (settings_plot_enabled)
            {
                int ret = k_msgq_put(&q_plot_ecg, &ecg_sensor_sample, K_NO_WAIT);
                if (ret != 0)
                {
                    static uint32_t plot_drops = 0;
                    plot_drops++;
                    if ((plot_drops % 10) == 0)
                    {
                        LOG_WRN("Plot queue full - dropped %u ECG sample batches", plot_drops);
                    }
                }
            }

            if (is_ecg_record_active == true)
            {
                int samples_to_copy = ecg_sensor_sample.ecg_num_samples;
                int space_left = ECG_RECORD_BUFFER_SAMPLES - ecg_record_counter;

                // Log sample count for debugging
                static uint32_t total_samples_recorded = 0;
                total_samples_recorded += samples_to_copy;

                if (samples_to_copy <= space_left)
                {
                    memcpy(&ecg_record_buffer[ecg_record_counter], ecg_sensor_sample.ecg_samples, samples_to_copy * sizeof(int32_t));
                    ecg_record_counter += samples_to_copy;
                    if (ecg_record_counter >= ECG_RECORD_BUFFER_SAMPLES)
                    {
                        ecg_record_counter = 0;
                    }
                }
                else
                {
                    // Copy in two parts: to end of buffer, then wrap around
                    memcpy(&ecg_record_buffer[ecg_record_counter], ecg_sensor_sample.ecg_samples, space_left * sizeof(int32_t));
                    memcpy(ecg_record_buffer, &ecg_sensor_sample.ecg_samples[space_left], (samples_to_copy - space_left) * sizeof(int32_t));
                    ecg_record_counter = samples_to_copy - space_left;
                }
            }
        }

        if (k_msgq_get(&q_bioz_sample, &bsample, K_NO_WAIT) == 0)
        {
            processed_data = true;
            if (settings_send_ble_enabled)
            {
                ble_gsr_notify(bsample.bioz_samples, bsample.bioz_num_samples);
            }
            if (settings_plot_enabled)
            {
                int ret = k_msgq_put(&q_plot_gsr, &bsample, K_NO_WAIT);
                if (ret != 0)
                {
                    static uint32_t plot_drops = 0;
                    plot_drops++;
                    if ((plot_drops % 10) == 0)
                    {
                        LOG_WRN("Plot queue full - dropped %u GSR sample batches", plot_drops);
                    }
                }
            }
        }

        if (k_msgq_get(&q_ppg_fi_sample, &ppg_fi_sensor_sample, K_NO_WAIT) == 0)
        {
            processed_data = true;
            if (settings_send_ble_enabled)
            {
                ble_ppg_notify_fi(ppg_fi_sensor_sample.raw_ir, ppg_fi_sensor_sample.ppg_num_samples);
            }
#if IS_ENABLED(CONFIG_OPENPPG)
            hpi_openppg_push_ppg_fi(&ppg_fi_sensor_sample);
#endif
            if (settings_plot_enabled)
            {
                k_msgq_put(&q_plot_ppg_fi, &ppg_fi_sensor_sample, K_NO_WAIT);
            }
        }

        // Check if PPG data is available
        if (k_msgq_get(&q_ppg_wrist_sample, &ppg_wr_sensor_sample, K_NO_WAIT) == 0)
        {
            processed_data = true;
            if (settings_send_ble_enabled)
            {
                ble_ppg_notify_wr(ppg_wr_sensor_sample.raw_green, ppg_wr_sensor_sample.ppg_num_samples);
            }
            if (settings_plot_enabled)
            {
                k_msgq_put(&q_plot_ppg_wrist, &ppg_wr_sensor_sample, K_NO_WAIT);
            }

#if IS_ENABLED(CONFIG_OPENPPG)
            hpi_openppg_push_ppg_wrist(&ppg_wr_sensor_sample);
#endif

            if (settings_send_usb_enabled)
            {
            }

            if (ppg_wr_sensor_sample.scd_state == HPI_PPG_SCD_ON_SKIN)
            {
                if (ppg_wr_sensor_sample.hr_confidence > 75)
                {
                    if (hr_zbus_last_pub_time == 0)
                    {
                        hr_zbus_last_pub_time = k_uptime_seconds();
                    }
                    if ((k_uptime_seconds() - hr_zbus_last_pub_time) > 2)
                    {
                        struct hpi_hr_t hr_chan_value = {
                            .timestamp = hw_get_sys_time_ts(),
                            .hr = ppg_wr_sensor_sample.hr,
                            .hr_ready_flag = true,
                        };
                        zbus_chan_pub(&hr_chan, &hr_chan_value, K_SECONDS(1));
                        hr_zbus_last_pub_time = k_uptime_seconds();
                    }
                }
            }
        }

        // Sleep longer if no data was processed to reduce CPU usage
        if (processed_data)
        {
            k_yield(); // Give other threads a chance to run
        }
        else
        {
            k_sleep(K_MSEC(1)); // Reduced sleep time to process samples faster
        }
    }
}

#define DATA_THREAD_STACKSIZE 4096
#define DATA_THREAD_PRIORITY 5 // Higher priority to process samples faster

K_THREAD_DEFINE(data_thread_id, DATA_THREAD_STACKSIZE, data_thread, NULL, NULL, NULL, DATA_THREAD_PRIORITY, 0, 1000);
```

## src/hpi_openppg.c
```c
// SPDX-License-Identifier: Apache-2.0

#include "hpi_openppg.h"

#include <string.h>

#include <zephyr/kernel.h>
#include <zephyr/logging/log.h>
#include <zephyr/sys/atomic.h>
#include <zephyr/sys/util.h>
LOG_MODULE_REGISTER(hpi_openppg, LOG_LEVEL_INF);

// OpenPPG core & proto (already in your tree)
#include <openppg/openppg_proto.h>
#include <openppg/openppg_api.h>  // publishes frames/status

#include "hpi_common_types.h"

// ---- Internal state ----

enum {
    OPPG_MODALITY_RED = 0,
    OPPG_MODALITY_IR = 1,
    OPPG_MODALITY_GREEN = 2,
};

enum {
    OPPG_QFMT_U20_RSHIFT4 = 0,
    OPPG_QFMT_S16 = 1,
    OPPG_QFMT_U24 = 2,
};

struct oppg_row {
    uint64_t timestamp_ms;
    int32_t  sample[HPI_OPPG_MAX_CH];
};

K_MSGQ_DEFINE(s_row_q, sizeof(struct oppg_row), HPI_OPPG_ROW_QUEUE_LEN, 4);

static struct {
    bool     configured;
    bool     running;
    uint32_t rate_hz;
    uint8_t  n_channels;          // <= HPI_OPPG_MAX_CH
    uint8_t  qfmt[HPI_OPPG_MAX_CH];  // openppg qfmt enums
    bool     ch0_green_not_red;   // true: map GREEN->ch0, false: RED->ch0
    uint16_t n_samples_per_frame; // frame batching
    uint16_t frame_seq;
    uint8_t  map_seq;
} s_cfg = {
    .configured = false,
    .running = false,
    .rate_hz = 100,
    .n_channels = MIN((uint8_t)3U, (uint8_t)HPI_OPPG_MAX_CH),
    .qfmt = {
        OPPG_QFMT_U24,
#if HPI_OPPG_MAX_CH > 1
        OPPG_QFMT_U24,
#endif
#if HPI_OPPG_MAX_CH > 2
        OPPG_QFMT_U24,
#endif
    }, // wire will be quantized later by core/codec
    .ch0_green_not_red = true,
    .n_samples_per_frame = HPI_OPPG_NSAMPLES_PER_FRAME,
    .frame_seq = 0,
    .map_seq = 0,
};

// ---- Helpers ----

static atomic_t s_drop_counter = ATOMIC_INIT(0);

static inline void publish_drop_counter(void)
{
    uint16_t drop_count = (uint16_t)atomic_get(&s_drop_counter);
    struct openppg_status_update status = {
        .status = OPENPPG_STATUS_OK,
        .warning_flags = 0,
        .reserved = {
            (uint8_t)(drop_count & 0xFF),
            (uint8_t)((drop_count >> 8) & 0xFF),
        },
    };

    (void)openppg_publish_status(&status);
}

static inline void push_row_samples(const int32_t samples[HPI_OPPG_MAX_CH])
{
    if (!s_cfg.running) return;

    struct oppg_row r = {
        .timestamp_ms = (uint64_t)k_uptime_get(), // TODO: swap for true wall-clock epoch when available
        .sample = { 0 },
    };

    uint8_t copy_count = MIN(s_cfg.n_channels, (uint8_t)HPI_OPPG_MAX_CH);
    for (uint8_t c = 0; c < copy_count; ++c) {
        r.sample[c] = samples[c];
    }

    // Observe queue occupancy in debug modes so we can detect backpressure quickly.
    uint32_t used = k_msgq_num_used_get(&s_row_q);
    if (used > (HPI_OPPG_ROW_QUEUE_LEN * 3U / 4U)) {
        LOG_INF("PPG queue pressure: %u/%u rows used", used, (uint32_t)HPI_OPPG_ROW_QUEUE_LEN);
    }

    if (k_msgq_put(&s_row_q, &r, K_NO_WAIT) != 0) {
        // Drop-oldest policy
        struct oppg_row throwaway;
        bool dropped = false;

        if (k_msgq_get(&s_row_q, &throwaway, K_NO_WAIT) == 0) {
            dropped = true;
        }
        if (k_msgq_put(&s_row_q, &r, K_NO_WAIT) != 0) {
            dropped = true;
        }
        if (dropped) {
            (void)atomic_inc(&s_drop_counter);
            static uint32_t last_warn_ms;
            uint32_t now_ms = k_uptime_get_32();
            if ((now_ms - last_warn_ms) > 1000U) {
                last_warn_ms = now_ms;
                LOG_INF("PPG row queue overflowed; dropped oldest sample set");
            }
            publish_drop_counter();
        }
    }
}

// ---- Public API ----

int hpi_openppg_init(void)
{
    // msgq already defined statically; nothing else for now
    return 0;
}

int hpi_openppg_configure_ppg(uint32_t rate_hz, bool use_green_for_ch0)
{
    bool was_configured = s_cfg.configured;
    bool prior_green = s_cfg.ch0_green_not_red;

    s_cfg.rate_hz = (rate_hz == 0) ? 100 : rate_hz;
    s_cfg.ch0_green_not_red = use_green_for_ch0;
    uint8_t max_channels = MIN((uint8_t)HPI_OPPG_MAX_CH, (uint8_t)OPENPPG_FRAME_MAX_CHANNELS);
    s_cfg.n_channels = MIN((uint8_t)3U, max_channels);
    for (uint8_t c = 0; c < s_cfg.n_channels; ++c) {
        s_cfg.qfmt[c] = OPPG_QFMT_U24;
    }
    s_cfg.configured = true;

    if (!was_configured || prior_green != use_green_for_ch0) {
        s_cfg.map_seq++;
    }

    return 0;
}

void hpi_openppg_push_ppg_wrist(const struct hpi_ppg_wr_data_t *b)
{
    if (!b || !s_cfg.configured) return;

    for (uint8_t i = 0; i < b->ppg_num_samples; ++i) {
        int32_t samples[HPI_OPPG_MAX_CH] = { 0 };

        if (HPI_OPPG_MAX_CH > 0) {
            samples[0] = s_cfg.ch0_green_not_red ? (int32_t)b->raw_green[i]
                                                 : (int32_t)b->raw_red[i];
        }
#if HPI_OPPG_MAX_CH > 1
        samples[1] = (int32_t)b->raw_ir[i];
#endif
#if HPI_OPPG_MAX_CH > 2
        samples[2] = s_cfg.ch0_green_not_red ? (int32_t)b->raw_red[i]
                                             : (int32_t)b->raw_green[i];
#endif

        push_row_samples(samples);
    }
}

void hpi_openppg_push_ppg_fi(const struct hpi_ppg_fi_data_t *b)
{
    if (!b || !s_cfg.configured) return;

    for (uint8_t i = 0; i < b->ppg_num_samples; ++i) {
        int32_t samples[HPI_OPPG_MAX_CH] = { 0 };

        if (HPI_OPPG_MAX_CH > 0 && !s_cfg.ch0_green_not_red) {
            samples[0] = (int32_t)b->raw_red[i];
        }
#if HPI_OPPG_MAX_CH > 1
        samples[1] = (int32_t)b->raw_ir[i];
#endif
#if HPI_OPPG_MAX_CH > 2
        if (s_cfg.ch0_green_not_red) {
            samples[2] = (int32_t)b->raw_red[i];
        }
#endif

        push_row_samples(samples);
    }
}

void hpi_openppg_push_ecg_bioz(const struct hpi_ecg_bioz_sensor_data_t *b)
{
    // Not wired for v1: we’re streaming PPG. You can extend mapping here later.
    ARG_UNUSED(b);
}

// ---- OpenPPG core HW hooks (these satisfy externs in openppg_core.c) ----

// NOTE: Your current core polls for full frames via openppg_hw_sample(). We assemble one
// by draining s_row_q up to n_samples_per_frame rows into the schema-aligned
// openppg_stream_frame, populating header metadata, channel_map, and interleaved samples.

// Quantize raw int32 to chosen qfmt range (very basic; refine as needed)
static inline int32_t clip_s16(int32_t v) { return (v < -32768) ? -32768 : (v > 32767 ? 32767 : v); }
static inline uint32_t to_u24(int32_t v)  { if (v < 0) v = 0; if (v > 0xFFFFFF) v = 0xFFFFFF; return (uint32_t)v; }

int openppg_hw_sample(struct openppg_stream_frame *frame)
{
    if (!s_cfg.running || !s_cfg.configured || !frame) return -EAGAIN;

    memset(frame, 0, sizeof(*frame));
    frame->schema_id = OPENPPG_SCHEMA_FRAME;

    // Compute width of one interleaved sample row based on channel formats.
    size_t row_bytes = 0;
    for (uint8_t c = 0; c < s_cfg.n_channels; ++c) {
        switch (s_cfg.qfmt[c]) {
        case OPPG_QFMT_S16:
            row_bytes += 2U;
            break;
        case OPPG_QFMT_U24:
        case OPPG_QFMT_U20_RSHIFT4:
            row_bytes += 3U;
            break;
        default:
            row_bytes += 3U;
            break;
        }
    }

    if (row_bytes == 0U) {
        return -EINVAL;
    }

    const uint16_t target_rows = MIN(s_cfg.n_samples_per_frame, (uint16_t)OPENPPG_FRAME_MAX_SAMPLES);
    const uint16_t max_rows_by_bytes = MIN(target_rows, (uint16_t)(OPENPPG_FRAME_MAX_SAMPLE_BYTES / row_bytes));

    if (max_rows_by_bytes == 0U) {
        return -EINVAL;
    }

    frame->header.num_channels = s_cfg.n_channels;
    frame->channel_count = s_cfg.n_channels;

    for (uint8_t c = 0; c < s_cfg.n_channels; ++c) {
        struct openppg_channel_desc *desc = &frame->channel_map[c];
        desc->id = c;
        desc->qfmt = s_cfg.qfmt[c];
        switch (s_cfg.qfmt[c]) {
        case OPPG_QFMT_S16:
            desc->adc_bits = 16U;
            break;
        case OPPG_QFMT_U20_RSHIFT4:
            desc->adc_bits = 20U;
            break;
        case OPPG_QFMT_U24:
        default:
            desc->adc_bits = 24U;
            break;
        }
        desc->wavelength_nm = 0U; // TODO: populate with sensor-specific wavelength when available

        switch (c) {
        case 0U:
            desc->modality = s_cfg.ch0_green_not_red ? OPPG_MODALITY_GREEN : OPPG_MODALITY_RED;
            break;
        case 1U:
            desc->modality = OPPG_MODALITY_IR;
            break;
        case 2U:
            desc->modality = s_cfg.ch0_green_not_red ? OPPG_MODALITY_RED : OPPG_MODALITY_GREEN;
            break;
        default:
            desc->modality = OPPG_MODALITY_IR;
            break;
        }
    }

    uint16_t got = 0;
    uint64_t first_ts = 0;
    uint8_t *p = frame->samples;

    while (got < max_rows_by_bytes) {
        struct oppg_row r;
        if (k_msgq_get(&s_row_q, &r, K_NO_WAIT) != 0) {
            break;
        }

        if (got == 0U) {
            first_ts = r.timestamp_ms;
        }

        for (uint8_t c = 0; c < s_cfg.n_channels; ++c) {
            int32_t v = r.sample[c];

            switch (s_cfg.qfmt[c]) {
            case OPPG_QFMT_S16: {
                int16_t s = (int16_t)clip_s16(v);
                p[0] = (uint8_t)(s & 0xFF);
                p[1] = (uint8_t)((s >> 8) & 0xFF);
                p += 2;
            } break;
            case OPPG_QFMT_U20_RSHIFT4: {
                uint32_t u = (uint32_t)((v < 0) ? 0 : v) & 0x000FFFFF;
                p[0] = (uint8_t)(u & 0xFF);
                p[1] = (uint8_t)((u >> 8) & 0xFF);
                p[2] = (uint8_t)((u >> 16) & 0x0F);
                p += 3;
            } break;
            case OPPG_QFMT_U24:
            default: {
                uint32_t u = to_u24(v);
                p[0] = (uint8_t)(u & 0xFF);
                p[1] = (uint8_t)((u >> 8) & 0xFF);
                p[2] = (uint8_t)((u >> 16) & 0xFF);
                p += 3;
            } break;
            }
        }

        got++;
    }

    if (got == 0U) {
        return -EAGAIN;
    }

    frame->header.timestamp_ms = first_ts;
    frame->header.sequence_number = s_cfg.frame_seq++;
    frame->header.num_samples = got;
    frame->header.has_sample_rate_hz = true;
    frame->header.sample_rate_hz = s_cfg.rate_hz;
    frame->header.has_map_seq = true;
    frame->header.map_seq = s_cfg.map_seq;

    frame->samples_len = got * row_bytes;
    frame->feature_count = 0U;

    return 0;
}

void openppg_hw_on_start(enum openppg_stream_rate rate)
{
    ARG_UNUSED(rate);
    s_cfg.running = true;
}

void openppg_hw_on_stop(void)
{
    s_cfg.running = false;
    k_msgq_purge(&s_row_q);
}

int openppg_hw_fetch_status(struct openppg_status_update *status)
{
    if (!status) return -EINVAL;
    status->status = OPENPPG_STATUS_OK;
    status->warning_flags = 0;
    uint16_t drop_count = (uint16_t)atomic_get(&s_drop_counter);
    status->reserved[0] = (uint8_t)(drop_count & 0xFF);
    status->reserved[1] = (uint8_t)((drop_count >> 8) & 0xFF);
    return 0;
}
```
